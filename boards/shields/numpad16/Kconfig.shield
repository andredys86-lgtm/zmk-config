## dts/bindings/behaviors/zmk,behavior-calc.yaml
```yaml
description: Standalone calculator key behavior

compatible: "zmk,behavior-calc"

include: one_param.yaml
```

## dts/bindings/behaviors/zmk,behavior-dyn.yaml
```yaml
description: Programmable key behavior (code taken from the user table)

compatible: "zmk,behavior-dyn"

include: one_param.yaml
```

## dts/bindings/behaviors/zmk,behavior-menu.yaml
```yaml
description: Programming menu control behavior

compatible: "zmk,behavior-menu"

include: one_param.yaml
```
